## apps/starry/orangepi-5-plus-selfbuild/orangepi5plus-selfbuild.its
```
/dts-v1/;

/ {
	description = "TGOSKits StarryOS OrangePi 5 Plus self-build";
	#address-cells = <1>;

	images {
		kernel {
			description = "StarryOS kernel";
			data = /incbin/("starryos.bin");
			type = "kernel";
			arch = "arm64";
			os = "linux";
			compression = "none";
			load = <0x00400000>;
			entry = <0x00400000>;

			hash-1 {
				algo = "sha256";
			};
		};

		fdt {
			description = "OrangePi 5 Plus Linux device tree";
			data = /incbin/("board.dtb");
			type = "flat_dt";
			arch = "arm64";
			compression = "none";
			load = <0x0a100000>;

			hash-1 {
				algo = "sha256";
			};
		};
	};

	configurations {
		default = "config-starry-selfbuild";

		config-starry-selfbuild {
			description = "StarryOS self-build on OrangePi 5 Plus";
			kernel = "kernel";
			fdt = "fdt";
		};
	};
};
```

## os/StarryOS/configs/board/bananapi-bpi-sm10.its
```
/dts-v1/;

/ {
    description = "StarryOS BananaPi BPI-SM10 high-address FIT";
    #address-cells = <2>;

    images {
        kernel {
            description = "StarryOS kernel";
            data = /incbin/("${kernel_bin}");
            type = "kernel";
            arch = "riscv";
            os = "linux";
            compression = "none";
            load = <0x00000001 0x02200000>;
            entry = <0x00000001 0x02200000>;

            hash {
                algo = "sha256";
            };
        };
    };

    configurations {
        default = "config-ostool";

        config-ostool {
            description = "ostool configuration";
            kernel = "kernel";
        };
    };
};
```

## results/atk-dlrk3588-task123-20260823/task1/configs/axvisor-task1-linux2-idle-fp-rr.its
```
/dts-v1/;

/ {
	description = "AxVisor ATK-DLRK3588 Task 1 2-vCPU Linux idle FP-RR (RAM boot)";
	#address-cells = <1>;
	images {
		kernel-1 {
			description = "AxVisor FP-RR with idle 2-vCPU Linux and RT-Thread probe";
			data = /incbin/("/home/huhu/atk-bringup/axvisor-task1-linux2-idle-fp-rr.bin");
			type = "kernel";
			arch = "arm64";
			os = "linux";
			compression = "none";
			load = <0x00400000>;
			entry = <0x00400000>;
			hash-1 { algo = "sha256"; };
		};
		fdt-1 {
			description = "ATK-DLRK3588 host device tree";
			data = /incbin/("/home/huhu/atk-bringup/atk-dlrk3588-starry.dtb");
			type = "flat_dt";
			arch = "arm64";
			compression = "none";
			load = <0x08300000>;
			hash-1 { algo = "sha256"; };
		};
	};
	configurations {
		default = "conf-1";
		conf-1 {
			description = "ATK-DLRK3588 Task 1 idle matrix RAM boot";
			kernel = "kernel-1";
			fdt = "fdt-1";
		};
	};
};
```

## results/atk-dlrk3588-task123-20260823/task1/configs/axvisor-task1-linux2-stability-fp-rr.its
```
/dts-v1/;

/ {
	description = "AxVisor ATK-DLRK3588 Task 1 10-minute stability FP-RR";
	#address-cells = <1>;
	images {
		kernel-1 {
			description = "AxVisor FP-RR 2-vCPU Linux 10-minute stability";
			data = /incbin/("/home/huhu/atk-bringup/axvisor-task1-linux2-stability-fp-rr.bin");
			type = "kernel";
			arch = "arm64";
			os = "linux";
			compression = "none";
			load = <0x00400000>;
			entry = <0x00400000>;
			hash-1 { algo = "sha256"; };
		};
		fdt-1 {
			description = "ATK-DLRK3588 host device tree";
			data = /incbin/("/home/huhu/atk-bringup/atk-dlrk3588-starry.dtb");
			type = "flat_dt";
			arch = "arm64";
			compression = "none";
			load = <0x08300000>;
			hash-1 { algo = "sha256"; };
		};
	};
	configurations {
		default = "conf-1";
		conf-1 {
			description = "ATK-DLRK3588 Task 1 10-minute stability RAM boot";
			kernel = "kernel-1";
			fdt = "fdt-1";
		};
	};
};
```

## results/atk-dlrk3588-task123-20260823/task1/configs/axvisor-task1-yolo-fp-rr.its
```
/dts-v1/;

/ {
	description = "AxVisor ATK-DLRK3588 Task 1 FP-RR YOLO A/B (RAM boot)";
	#address-cells = <1>;

	images {
		kernel-1 {
			description = "AxVisor FP-RR with StarryOS YOLO and RT-Thread periodic probe";
			data = /incbin/("/home/huhu/atk-bringup/axvisor-task1-yolo-fp-rr.bin");
			type = "kernel";
			arch = "arm64";
			os = "linux";
			compression = "none";
			load = <0x00400000>;
			entry = <0x00400000>;
			hash-1 { algo = "sha256"; };
		};
		fdt-1 {
			description = "ATK-DLRK3588 host device tree";
			data = /incbin/("/home/huhu/atk-bringup/atk-dlrk3588-starry.dtb");
			type = "flat_dt";
			arch = "arm64";
			compression = "none";
			load = <0x08300000>;
			hash-1 { algo = "sha256"; };
		};
	};

	configurations {
		default = "conf-1";
		conf-1 {
			description = "ATK-DLRK3588 Task 1 FP-RR YOLO RAM boot";
			kernel = "kernel-1";
			fdt = "fdt-1";
		};
	};
};
```

## results/atk-dlrk3588-task123-20260823/task23/axvisor-task23-fifo.its
```
/dts-v1/;

/ {
	description = "AxVisor ATK-DLRK3588 Task 2/3 FIFO control validation";
	#address-cells = <1>;

	images {
		kernel-1 {
			description = "AxVisor FIFO host with StarryOS YOLO and RT-Thread control guest";
			data = /incbin/("/home/huhu/atk-bringup/axvisor-task23-fifo.bin");
			type = "kernel";
			arch = "arm64";
			os = "linux";
			compression = "none";
			load = <0x00400000>;
			entry = <0x00400000>;

			hash-1 {
				algo = "sha256";
			};
		};

		fdt-1 {
			description = "ATK-DLRK3588 host device tree";
			data = /incbin/("/home/huhu/atk-bringup/atk-dlrk3588-starry.dtb");
			type = "flat_dt";
			arch = "arm64";
			compression = "none";
			load = <0x08300000>;

			hash-1 {
				algo = "sha256";
			};
		};
	};

	configurations {
		default = "conf-1";

		conf-1 {
			description = "ATK-DLRK3588 Task 2/3 FIFO RAM boot";
			kernel = "kernel-1";
			fdt = "fdt-1";
		};
	};
};
```

## results/atk-dlrk3588-task123-integrated-ab-20260824/configs/axvisor-task123-integrated-fp-rr.its
```
/dts-v1/;

/ {
	description = "AxVisor ATK-DLRK3588 integrated Task 1/2/3 FP-RR";
	#address-cells = <1>;

	images {
		kernel-1 {
			description = "AxVisor FP-RR with StarryOS AI and RT-Thread control";
			data = /incbin/("/home/huhu/tgoskits-starry/tmp/atk-task123-integrated-ab-20260824/axvisor-task123-integrated-fp-rr.bin");
			type = "kernel";
			arch = "arm64";
			os = "linux";
			compression = "none";
			load = <0x00400000>;
			entry = <0x00400000>;

			hash-1 {
				algo = "sha256";
			};
		};

		fdt-1 {
			description = "ATK-DLRK3588 host device tree";
			data = /incbin/("/home/huhu/atk-bringup/atk-dlrk3588-starry.dtb");
			type = "flat_dt";
			arch = "arm64";
			compression = "none";
			load = <0x08300000>;

			hash-1 {
				algo = "sha256";
			};
		};
	};

	configurations {
		default = "conf-1";

		conf-1 {
			description = "ATK-DLRK3588 integrated Task 1/2/3 FP-RR RAM boot";
			kernel = "kernel-1";
			fdt = "fdt-1";
		};
	};
};
```
