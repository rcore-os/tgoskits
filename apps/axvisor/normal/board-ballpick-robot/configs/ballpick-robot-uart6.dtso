/dts-v1/;
/plugin/;

/ {
    fragment@0 {
        target-path = "/serial@feb90000";

        __overlay__ {
            status = "okay";
            pinctrl-names = "default";
            pinctrl-0 = <&uart6m1_xfer>;
        };
    };
};
