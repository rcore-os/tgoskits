## CMakeLists.txt
```
cmake_minimum_required(VERSION 3.20.0)
find_package(Zephyr REQUIRED HINTS $ENV{ZEPHYR_BASE})
project(axvisor_ivshmem_sdk_peer)

if(EXISTS "${CMAKE_CURRENT_LIST_DIR}/common/include/ivc_sdk.h")
  set(IVC_COMMON_DIR "${CMAKE_CURRENT_LIST_DIR}/common")
else()
  set(IVC_COMMON_DIR "${CMAKE_CURRENT_LIST_DIR}/../common")
endif()

target_sources(app PRIVATE
  src/main.cpp
  src/ivc_platform.c
  ${IVC_COMMON_DIR}/src/ivc_ring.c
  ${IVC_COMMON_DIR}/src/ivc_client.c
  ${IVC_COMMON_DIR}/src/ivc_demo.c
  ${IVC_COMMON_DIR}/src/ivc_sdk.c
)
target_include_directories(app PRIVATE ${IVC_COMMON_DIR}/include)
```

## prj.conf
```kconfig
CONFIG_CPP=y
CONFIG_MAIN_STACK_SIZE=8192
CONFIG_PRINTK=y
CONFIG_SERIAL=y
```

## src/main.cpp
```c
#include "ivc_sdk.h"

#include <stdint.h>
#include <string.h>
#include <zephyr/kernel.h>
#include <zephyr/sys/printk.h>

#define IMAGE_BYTES (256U * 1024U)
#define TIMEOUT_LOOPS 60000U
#define POLL_INTERVAL_US 1000U
#define PSCI_SYSTEM_OFF 0x84000008UL

static uint8_t tx_image[IMAGE_BYTES];
static uint8_t msg_payload[512];

static void psci_system_off(void)
{
    register uint64_t x0 __asm__("x0") = PSCI_SYSTEM_OFF;
    __asm__ volatile("smc #0" : "+r"(x0) : : "memory");
}

static void prepare_message(struct ivc_message *msg, void *payload,
                            uint32_t capacity)
{
    memset(msg, 0, sizeof(*msg));
    memset(payload, 0, capacity);
    msg->payload = payload;
    msg->payload_capacity = capacity;
}

static int recv_with_poll(struct ivc_sdk *sdk, struct ivc_message *msg,
                          const char *what)
{
    for (uint32_t i = 0; i < TIMEOUT_LOOPS; i++) {
        int rc = ivc_sdk_recv(sdk, msg, IVC_RECV_NO_WAIT);
        if (rc == IVC_OK) {
            return 0;
        }
        if (rc != IVC_ERR_EMPTY) {
            printk("Zephyr ivshmem failed: recv %s rc=%d\n", what, rc);
            return rc;
        }
        k_busy_wait(POLL_INTERVAL_US);
    }
    printk("Zephyr ivshmem failed: timeout waiting for %s\n", what);
    return IVC_ERR_TIMEOUT;
}

static void fill_image(uint8_t *data, uint32_t len)
{
    for (uint32_t i = 0; i < len; i++) {
        data[i] = (uint8_t)(i * 7U + 3U);
    }
}

int main(void)
{
    struct ivc_sdk sdk {};
    struct ivc_sdk_image image {};
    struct ivc_sdk_control_view control {};
    struct ivc_pending_entry completed {};
    struct ivc_message msg {};
    uint64_t image_seq = 0;

    printk("Zephyr ivshmem SDK peer init\n");
    if (ivc_sdk_open_default(&sdk, IVC_PEER_ZEPHYR) != IVC_OK) {
        return 1;
    }
    printk("Zephyr SDK ready\n");

    fill_image(tx_image, sizeof(tx_image));
    image.image_id = 42;
    image.width = 1024;
    image.height = 256;
    image.pixel_format = IVC_PIXEL_FORMAT_GRAY8;
    image.data = tx_image;
    image.data_len = sizeof(tx_image);
    if (ivc_sdk_send_image(&sdk, &image, 1000, 1000, &image_seq) != IVC_OK) {
        printk("Zephyr ivshmem failed: send image failed\n");
        return 1;
    }
    printk("Zephyr SDK sends image seq=%llu image_id=%llu bytes=%u\n",
           (unsigned long long)image_seq, (unsigned long long)image.image_id,
           image.data_len);

    prepare_message(&msg, msg_payload, sizeof(msg_payload));
    if (recv_with_poll(&sdk, &msg, "Linux control") != 0) {
        return 1;
    }
    if (ivc_sdk_recv_control(&msg, &control) != IVC_OK) {
        printk("Zephyr ivshmem failed: parse control failed\n");
        return 1;
    }
    if (ivc_sdk_complete_reply(&sdk, &msg, &completed) != IVC_OK ||
        completed.user_data != image.image_id) {
        printk("Zephyr ivshmem failed: complete image pending failed\n");
        return 1;
    }
    printk("Zephyr SDK receives control seq=%llu reply_to=%llu\n",
           (unsigned long long)msg.header.seq,
           (unsigned long long)msg.header.reply_to);
    printk("Zephyr executes CONTROL_CMD immediately\n");

    if (ivc_sdk_reply_control_result(&sdk, &msg, control.command,
                                     IVC_CONTROL_OK, control.target_id, NULL) !=
        IVC_OK) {
        printk("Zephyr ivshmem failed: reply control result failed\n");
        return 1;
    }
    printk("Zephyr SDK replies control result\n");

    k_sleep(K_MSEC(1000));
    psci_system_off();
    printk("Zephyr ivshmem failed: PSCI SYSTEM_OFF returned\n");
    return 1;
}
```

## src/ivc_platform.c
```c
#include "ivc_sdk.h"

#include <stdint.h>
#include <string.h>
#include <zephyr/arch/arm64/arm_mem.h>
#include <zephyr/kernel.h>
#include <zephyr/kernel/mm.h>
#include <zephyr/sys/printk.h>

#define IVSHMEM_BAR0_PHYS 0x50100000UL
#define IVSHMEM_BAR0_SIZE 0x1000UL
#define IVSHMEM_BAR2_PHYS 0x50200000UL
#define IVSHMEM_BAR2_SIZE 0x200000UL
#define IVSHMEM_BAR0_DOORBELL_WORD 3U
#define TIMEOUT_LOOPS 60000U
#define POLL_INTERVAL_US 1000U

struct ivc_default_platform {
    struct ivc_sdk *sdk;
    struct ivc_pending_entry pending[8];
    void *shared_mem;
    uint32_t shared_mem_size;
    volatile uint32_t *doorbell_regs;
    uint32_t doorbell_value;
};

static struct ivc_default_platform g_platform;

static void platform_doorbell(void *ctx)
{
    struct ivc_default_platform *platform = ctx;
    platform->doorbell_regs[IVSHMEM_BAR0_DOORBELL_WORD] =
        platform->doorbell_value;
}

static int wait_shared_ready(void *bar2)
{
    volatile struct ivc_shared_header *shared =
        (volatile struct ivc_shared_header *)bar2;

    for (uint32_t i = 0; i < TIMEOUT_LOOPS; i++) {
        if (shared->magic == IVC_SHARED_MAGIC &&
            shared->version == IVC_SHARED_VERSION &&
            shared->header_len == IVC_SHARED_HEADER_SIZE) {
            __sync_synchronize();
            return 0;
        }
        k_busy_wait(POLL_INTERVAL_US);
    }
    printk("Zephyr ivshmem failed: timeout waiting for shared header\n");
    return -1;
}

int ivc_sdk_open_default(struct ivc_sdk *sdk, enum ivc_peer peer)
{
    struct ivc_default_platform *platform = &g_platform;
    mm_reg_t bar0_addr = 0;
    mm_reg_t bar2_addr = 0;
    int rc;

    if (sdk == NULL) {
        return IVC_ERR_INVALID_ARG;
    }
    if (peer != IVC_PEER_ZEPHYR) {
        return IVC_ERR_INVALID_ARG;
    }

    ivc_sdk_close(sdk);
    memset(platform, 0, sizeof(*platform));
    device_map(&bar0_addr, IVSHMEM_BAR0_PHYS, IVSHMEM_BAR0_SIZE,
               K_MEM_ARM_DEVICE_nGnRE);
    device_map(&bar2_addr, IVSHMEM_BAR2_PHYS, IVSHMEM_BAR2_SIZE,
               K_MEM_ARM_NORMAL_NC);
    printk("Zephyr ivshmem mapped bar0=0x%lx bar2=0x%lx\n",
           (unsigned long)bar0_addr, (unsigned long)bar2_addr);

    if (wait_shared_ready((void *)bar2_addr) != 0) {
        return IVC_ERR_TIMEOUT;
    }

    platform->doorbell_regs = (volatile uint32_t *)bar0_addr;
    platform->doorbell_value = 2U;
    platform->shared_mem = (void *)bar2_addr;
    platform->shared_mem_size = IVSHMEM_BAR2_SIZE;

    rc = ivc_sdk_init(sdk, platform->shared_mem,
                      platform->shared_mem_size, IVC_PEER_ZEPHYR,
                      platform_doorbell, platform, NULL, NULL);
    if (rc != IVC_OK) {
        printk("Zephyr ivshmem failed: SDK init failed rc=%d\n", rc);
        ivc_sdk_close(sdk);
        return rc;
    }

    platform->sdk = sdk;
    ivc_sdk_set_pending_table(sdk, platform->pending,
                              sizeof(platform->pending) /
                                  sizeof(platform->pending[0]));
    return IVC_OK;
}

void ivc_sdk_close(struct ivc_sdk *sdk)
{
    struct ivc_default_platform *platform = &g_platform;

    if (sdk != NULL && platform->sdk != NULL && platform->sdk != sdk) {
        return;
    }
    if (platform->sdk != NULL) {
        memset(platform->sdk, 0, sizeof(*platform->sdk));
    } else if (sdk != NULL) {
        memset(sdk, 0, sizeof(*sdk));
    }
    memset(platform, 0, sizeof(*platform));
}
```
