## CMakeLists.txt
```
# SPDX-License-Identifier: Apache-2.0

cmake_minimum_required(VERSION 3.20.0)
find_package(Zephyr 4.3.0 REQUIRED HINTS $ENV{ZEPHYR_BASE})
project(ivc_zephyr_endpoint C)

target_sources(app PRIVATE
  src/endpoint.c
  src/main.c
  src/protocol.c
)

target_include_directories(app PRIVATE src)
target_compile_options(app PRIVATE -Wall -Wextra -Werror)
```

## Kconfig
```
# SPDX-License-Identifier: Apache-2.0

mainmenu "Zephyr IVC control endpoint"

source "Kconfig.zephyr"

menu "IVC reliability evidence"

config IVC_DROP_ACK_EVERY
	int "Drop the first ACK for every Nth fresh command"
	range 0 1000000
	default 0
	help
	  Set to zero for the normal endpoint. A positive value enables the
	  deterministic cross-guest ACK-loss profile: the endpoint suppresses the
	  ACK for each Nth freshly applied command, then responds normally when the
	  controller retransmits that command.

config IVC_EXPECTED_COMMANDS
	int "Expected commands in a finite evidence run"
	range 0 1000000
	default 0
	help
	  Set to zero for an open-ended normal endpoint. A positive count emits one
	  terminal IVC-RTOS-RESULT record after all fresh commands are observed. The
	  deterministic ACK-loss profile additionally waits for the expected
	  retransmitted duplicates.

config IVC_EXPECTED_PROTOCOL_ERRORS
	int "Expected ERROR responses in a finite evidence run"
	range 0 1000000
	default 0
	help
	  Set to zero for normal and ACK-loss endpoints. A positive value selects
	  the deterministic malformed-frame profile and delays the terminal result
	  until every expected protocol rejection has produced an ERROR response.

config IVC_EXPECTED_SESSION_RESETS
	int "Expected accepted controller session replacements"
	range 0 1000000
	default 0
	help
	  A positive value selects the restart-recovery profile and delays the
	  terminal result until this many fresh sessions have replaced a prior
	  controller session.

config IVC_EXPECTED_SESSION_REJECTIONS
	int "Expected rejected retired-session controls"
	range 0 1000000
	default 0
	help
	  Number of delayed controls from retired sessions that must be rejected.
	  This is independent from duplicate delivery within the active session.

config IVC_EXPECTED_SAFE_FALLBACKS
	int "Expected controller-timeout safe fallbacks"
	range 0 1000000
	default 0
	help
	  Number of controller-silence events that must enter the actuator safe
	  state. Every expected fallback must subsequently recover through a valid
	  command before the restart profile can complete.

config IVC_EXIT_AFTER_EXPECTED_COMMANDS
	bool "Power off after a finite evidence run"
	depends on IVC_EXPECTED_COMMANDS > 0
	depends on POWEROFF
	default n
	help
	  Power off through PSCI after the terminal IVC-RTOS-RESULT record. Keep
	  this disabled for interactive and open-ended demonstrations. Enable it
	  for automated physical-board runs so AxVisor can regain its shell after
	  every guest has completed.

endmenu
```

## prj.conf
```kconfig
# SPDX-License-Identifier: Apache-2.0

CONFIG_MAIN_STACK_SIZE=8192
CONFIG_HEAP_MEM_POOL_SIZE=32768
CONFIG_FPU=y
CONFIG_PRINTK=y
CONFIG_LOG=n
CONFIG_COMPILER_OPT="-mno-outline-atomics"
CONFIG_ARMV8_A_NS=y
CONFIG_GIC_SAFE_CONFIG=y

# qemu_cortex_a53 has no entropy device; networking still needs sys_rand_get().
CONFIG_TEST_RANDOM_GENERATOR=y

CONFIG_NETWORKING=y
CONFIG_NET_NATIVE=y
CONFIG_NET_L2_ETHERNET=y
CONFIG_ETH_VIRTIO_NET=y
CONFIG_ETH_VIRTIO_NET_RX_BUFFERS=8

CONFIG_NET_IPV4=y
CONFIG_NET_IPV6=n
CONFIG_NET_UDP=y
CONFIG_NET_TCP=n
CONFIG_NET_SOCKETS=y
CONFIG_ZVFS_POLL_MAX=1

CONFIG_NET_CONFIG_SETTINGS=y
CONFIG_NET_CONFIG_AUTO_INIT=y
CONFIG_NET_CONFIG_NEED_IPV4=y
CONFIG_NET_CONFIG_MY_IPV4_ADDR="10.0.0.2"
CONFIG_NET_CONFIG_MY_IPV4_NETMASK="255.255.255.0"
CONFIG_NET_CONFIG_PEER_IPV4_ADDR="10.0.0.1"
CONFIG_NET_CONFIG_INIT_TIMEOUT=0

# QEMU's Ethernet choice lets the runner derive model=virtio from the driver.
CONFIG_NET_QEMU_ETHERNET=y

CONFIG_NET_PKT_RX_COUNT=16
CONFIG_NET_PKT_TX_COUNT=16
CONFIG_NET_BUF_RX_COUNT=32
CONFIG_NET_BUF_TX_COUNT=32
```

## ack-loss.conf
```kconfig
# SPDX-License-Identifier: Apache-2.0

# Dedicated 100-command cross-guest reliability campaign.
CONFIG_IVC_DROP_ACK_EVERY=5
CONFIG_IVC_EXPECTED_COMMANDS=100
```

## board-ack-loss.conf
```kconfig
# SPDX-License-Identifier: Apache-2.0

# Finite deterministic ACK-loss profile for physical-board evidence.
CONFIG_PM_CPU_OPS=y
CONFIG_POWEROFF=y
CONFIG_IVC_DROP_ACK_EVERY=5
CONFIG_IVC_EXPECTED_COMMANDS=100
CONFIG_IVC_EXIT_AFTER_EXPECTED_COMMANDS=y
```

## board-error.conf
```kconfig
# SPDX-License-Identifier: Apache-2.0

# Finite malformed-frame and protocol-state profile for physical-board evidence.
CONFIG_PM_CPU_OPS=y
CONFIG_POWEROFF=y
CONFIG_IVC_DROP_ACK_EVERY=0
CONFIG_IVC_EXPECTED_COMMANDS=100
CONFIG_IVC_EXPECTED_PROTOCOL_ERRORS=5
CONFIG_IVC_EXIT_AFTER_EXPECTED_COMMANDS=y
```

## board-restart.conf
```kconfig
# SPDX-License-Identifier: Apache-2.0

# Finite physical StarryOS VM-reset and controller-session recovery profile.
CONFIG_PM_CPU_OPS=y
CONFIG_POWEROFF=y
CONFIG_IVC_DROP_ACK_EVERY=0
CONFIG_IVC_EXPECTED_COMMANDS=120
CONFIG_IVC_EXPECTED_PROTOCOL_ERRORS=1
CONFIG_IVC_EXPECTED_SESSION_RESETS=1
CONFIG_IVC_EXPECTED_SESSION_REJECTIONS=1
CONFIG_IVC_EXPECTED_SAFE_FALLBACKS=1
CONFIG_IVC_EXIT_AFTER_EXPECTED_COMMANDS=y
```

## board-smoke.conf
```kconfig
# SPDX-License-Identifier: Apache-2.0

# Finite profile for an automated physical-board smoke run. PSCI SYSTEM_OFF
# returns control to AxVisor after the controller receives all responses.
CONFIG_PM_CPU_OPS=y
CONFIG_POWEROFF=y
CONFIG_IVC_EXPECTED_COMMANDS=20
CONFIG_IVC_EXIT_AFTER_EXPECTED_COMMANDS=y
```

## board.conf
```kconfig
# SPDX-License-Identifier: Apache-2.0

# Finite profile for the full physical-board evidence run.
CONFIG_PM_CPU_OPS=y
CONFIG_POWEROFF=y
CONFIG_IVC_EXPECTED_COMMANDS=1800
CONFIG_IVC_EXIT_AFTER_EXPECTED_COMMANDS=y
```

## boards/qemu_cortex_a53.overlay
```dts
/* SPDX-License-Identifier: Apache-2.0 */

/*
 * QEMU virt slot 16 is 0x0a002000. Its GIC cell is SPI 32, which maps to
 * architectural INTID 64. The parent board DTS already supplies reg/interrupts.
 */
&virtio_mmio16 {
	status = "okay";

	ivc_virtio_net: ethernet {
		compatible = "virtio,net";
		local-mac-address = [52 54 00 00 00 02];
		status = "okay";
	};
};

/* The AxVisor guest exposes only the slot-16 virtio-net device. */
&eth0 {
	status = "disabled";
};
```

## src/endpoint.c
```c
/* SPDX-License-Identifier: Apache-2.0 */

#include "endpoint.h"

#include <limits.h>

static bool control_valid(const struct ivc_control_command *command)
{
	if (command == NULL || command->operation < IVC_CONTROL_SET_ACTUATOR ||
	    command->operation > IVC_CONTROL_HEARTBEAT || command->mode < IVC_MODE_SAFE ||
	    command->mode > IVC_MODE_NEURAL ||
	    command->actuator_permille > IVC_MAX_ACTUATOR_PERMILLE ||
	    command->setpoint_milli_c < IVC_MIN_TEMPERATURE_MILLI_C ||
	    command->setpoint_milli_c > IVC_MAX_TEMPERATURE_MILLI_C) {
		return false;
	}
	return command->operation != IVC_CONTROL_ENTER_SAFE_STATE || command->mode == IVC_MODE_SAFE;
}

static void enter_safe_state(struct ivc_endpoint *endpoint, enum ivc_error_code fault)
{
	endpoint->active_mode = IVC_MODE_SAFE;
	endpoint->actuator_permille = IVC_SAFE_ACTUATOR_PERMILLE;
	endpoint->fault = fault;
}

static bool session_retired(const struct ivc_receive_window *window, uint32_t session_id)
{
	uint8_t index;

	for (index = 0U; index < window->retired_session_count; ++index) {
		if (window->retired_sessions[index] == session_id) {
			return true;
		}
	}
	return false;
}

static void retire_session(struct ivc_receive_window *window, uint32_t session_id)
{
	window->retired_sessions[window->retired_session_cursor] = session_id;
	window->retired_session_cursor =
		(uint8_t)((window->retired_session_cursor + 1U) % IVC_RETIRED_SESSION_CAPACITY);
	if (window->retired_session_count < IVC_RETIRED_SESSION_CAPACITY) {
		++window->retired_session_count;
	}
}

void ivc_receive_window_init(struct ivc_receive_window *window)
{
	*window = (struct ivc_receive_window){
		.next_sequence = 1U,
	};
}

enum ivc_delivery ivc_receive_window_observe(struct ivc_receive_window *window,
					      uint32_t session_id, uint32_t sequence)
{
	uint32_t offset;
	uint64_t bit;
	bool new_session = false;

	if (window == NULL || session_id == 0U || sequence == 0U) {
		return IVC_DELIVERY_INVALID_IDENTIFIER;
	}
	if (!window->has_session) {
		new_session = true;
	} else if (window->session_id != session_id) {
		if (sequence != 1U || session_retired(window, session_id)) {
			++window->metrics.session_rejections;
			return IVC_DELIVERY_SESSION_REJECTED;
		}
		retire_session(window, window->session_id);
		++window->metrics.session_resets;
		new_session = true;
	}
	if (new_session) {
		window->has_session = true;
		window->session_id = session_id;
		window->next_sequence = 1U;
		window->received_mask = 0U;
	}
	if (sequence < window->next_sequence) {
		++window->metrics.duplicates;
		return IVC_DELIVERY_DUPLICATE;
	}
	offset = sequence - window->next_sequence;
	if (offset >= IVC_RECEIVE_WINDOW_BITS) {
		++window->metrics.outside_window;
		return IVC_DELIVERY_OUTSIDE_WINDOW;
	}
	bit = UINT64_C(1) << offset;
	if ((window->received_mask & bit) != 0U) {
		++window->metrics.duplicates;
		return IVC_DELIVERY_DUPLICATE;
	}
	window->received_mask |= bit;
	++window->metrics.accepted;
	if (offset != 0U) {
		++window->metrics.reordered;
	}
	while ((window->received_mask & UINT64_C(1)) != 0U) {
		window->received_mask >>= 1;
		if (window->next_sequence == UINT32_MAX) {
			return IVC_DELIVERY_SEQUENCE_EXHAUSTED;
		}
		++window->next_sequence;
	}
	if (new_session) {
		return offset == 0U ? IVC_DELIVERY_NEW_SESSION : IVC_DELIVERY_NEW_OUT_OF_ORDER;
	}
	return offset == 0U ? IVC_DELIVERY_NEW_IN_ORDER : IVC_DELIVERY_NEW_OUT_OF_ORDER;
}

bool ivc_delivery_applies_control(enum ivc_delivery delivery)
{
	return delivery == IVC_DELIVERY_NEW_SESSION || delivery == IVC_DELIVERY_NEW_IN_ORDER;
}

struct ivc_ack_payload ivc_receive_window_ack(const struct ivc_receive_window *window,
					      uint32_t acknowledged_sequence)
{
	return (struct ivc_ack_payload){
		.acknowledged_sequence = acknowledged_sequence,
		.next_expected_sequence = window->next_sequence,
		/* The Rust wire contract intentionally exports only the low 32 bits. */
		.received_mask = (uint32_t)window->received_mask,
	};
}

void ivc_ack_loss_policy_init(struct ivc_ack_loss_policy *policy, uint32_t drop_every)
{
	*policy = (struct ivc_ack_loss_policy){
		.drop_every = drop_every,
	};
}

bool ivc_ack_loss_policy_should_drop(struct ivc_ack_loss_policy *policy,
				     enum ivc_delivery delivery, uint32_t sequence)
{
	bool fresh;

	if (policy == NULL || policy->drop_every == 0U || sequence == 0U) {
		return false;
	}
	fresh = ivc_delivery_applies_control(delivery);
	if (!fresh || (sequence % policy->drop_every) != 0U) {
		return false;
	}
	++policy->acknowledgements_dropped;
	return true;
}

void ivc_endpoint_init(struct ivc_endpoint *endpoint)
{
	*endpoint = (struct ivc_endpoint){
		.active_mode = IVC_MODE_SAFE,
		.actuator_permille = IVC_SAFE_ACTUATOR_PERMILLE,
		.setpoint_milli_c = IVC_INITIAL_SETPOINT_MILLI_C,
		.fault = IVC_ERROR_NONE,
	};
}

void ivc_endpoint_begin_session(struct ivc_endpoint *endpoint)
{
	endpoint->last_sequence = 0U;
	endpoint->has_last_sample = false;
	endpoint->last_sample_id = 0U;
}

enum ivc_apply_result ivc_endpoint_apply(struct ivc_endpoint *endpoint, uint32_t sequence,
					 const struct ivc_control_command *command,
					 uint64_t sent_at_us, uint64_t now_us)
{
	uint64_t age_us;

	if (endpoint == NULL || !control_valid(command)) {
		return IVC_APPLY_INVALID_PAYLOAD;
	}
	if (now_us < sent_at_us) {
		return IVC_APPLY_FUTURE_TIMESTAMP;
	}
	age_us = now_us - sent_at_us;
	if (age_us > IVC_MAXIMUM_COMMAND_AGE_US) {
		return IVC_APPLY_STALE_TIMESTAMP;
	}
	if (sequence <= endpoint->last_sequence) {
		return IVC_APPLY_STALE_SEQUENCE;
	}
	if (endpoint->has_last_sample && command->sample_id <= endpoint->last_sample_id) {
		return IVC_APPLY_STALE_SAMPLE;
	}

	endpoint->last_sequence = sequence;
	endpoint->has_last_sample = true;
	endpoint->last_sample_id = command->sample_id;
	endpoint->has_last_valid_command = true;
	endpoint->last_valid_command_us = now_us;
	endpoint->setpoint_milli_c = command->setpoint_milli_c;
	endpoint->fault = IVC_ERROR_NONE;
	if (command->operation == IVC_CONTROL_ENTER_SAFE_STATE) {
		enter_safe_state(endpoint, IVC_ERROR_NONE);
		return IVC_APPLY_ENTERED_SAFE_STATE;
	}
	endpoint->active_mode = command->mode;
	endpoint->actuator_permille = command->actuator_permille;
	return IVC_APPLY_APPLIED;
}

enum ivc_timeout_result ivc_endpoint_check_timeout(struct ivc_endpoint *endpoint,
						   uint64_t now_us)
{
	uint64_t silence_us;

	if (endpoint == NULL || !endpoint->has_last_valid_command) {
		return IVC_TIMEOUT_NO_CHANGE;
	}
	if (now_us < endpoint->last_valid_command_us) {
		return IVC_TIMEOUT_CLOCK_MOVED_BACKWARD;
	}
	silence_us = now_us - endpoint->last_valid_command_us;
	if (silence_us <= IVC_COMMAND_TIMEOUT_US) {
		return IVC_TIMEOUT_NO_CHANGE;
	}
	if (endpoint->active_mode == IVC_MODE_SAFE &&
	    endpoint->actuator_permille == IVC_SAFE_ACTUATOR_PERMILLE &&
	    endpoint->fault == IVC_ERROR_CONTROLLER_TIMEOUT) {
		return IVC_TIMEOUT_NO_CHANGE;
	}
	enter_safe_state(endpoint, IVC_ERROR_CONTROLLER_TIMEOUT);
	return IVC_TIMEOUT_ENTERED_SAFE_STATE;
}

struct ivc_status_report ivc_endpoint_status(const struct ivc_endpoint *endpoint,
					     int32_t measured_milli_c)
{
	enum ivc_status_state state;

	if (endpoint->fault == IVC_ERROR_CONTROLLER_TIMEOUT) {
		state = IVC_STATUS_SAFE_FALLBACK;
	} else if (endpoint->last_sequence == 0U) {
		state = IVC_STATUS_READY;
	} else {
		state = IVC_STATUS_APPLIED;
	}
	return (struct ivc_status_report){
		.state = state,
		.active_mode = endpoint->active_mode,
		.actuator_permille = endpoint->actuator_permille,
		.measured_milli_c = measured_milli_c,
		.setpoint_milli_c = endpoint->setpoint_milli_c,
		.applied_sequence = endpoint->last_sequence,
		.fault = endpoint->fault,
	};
}

const char *ivc_control_mode_name(enum ivc_control_mode mode)
{
	switch (mode) {
	case IVC_MODE_SAFE:
		return "Safe";
	case IVC_MODE_MANUAL_FIXED:
		return "ManualFixed";
	case IVC_MODE_NEURAL:
		return "Neural";
	default:
		return "Unknown";
	}
}

const char *ivc_apply_result_name(enum ivc_apply_result result)
{
	switch (result) {
	case IVC_APPLY_APPLIED:
		return "applied";
	case IVC_APPLY_ENTERED_SAFE_STATE:
		return "entered-safe-state";
	case IVC_APPLY_INVALID_PAYLOAD:
		return "invalid-payload";
	case IVC_APPLY_FUTURE_TIMESTAMP:
		return "future-timestamp";
	case IVC_APPLY_STALE_TIMESTAMP:
		return "stale-timestamp";
	case IVC_APPLY_STALE_SEQUENCE:
		return "stale-sequence";
	case IVC_APPLY_STALE_SAMPLE:
		return "stale-sample";
	default:
		return "unknown-apply-result";
	}
}

void ivc_thermal_plant_init(struct ivc_thermal_plant *plant)
{
	plant->temperature_c = (float)IVC_INITIAL_TEMPERATURE_MILLI_C / 1000.0F;
}

void ivc_thermal_plant_step(struct ivc_thermal_plant *plant, uint16_t actuator_permille,
			    uint32_t step)
{
	const float ambient_c = 20.0F;
	const float heater_c_per_s = 2.8F;
	const float cooling_per_s = 0.04F;
	const float dt_s = 0.1F;
	const float actuator = (float)actuator_permille / 1000.0F;
	const float disturbance = step >= 850U && step < 950U ? -0.35F : 0.0F;
	const float derivative = heater_c_per_s * actuator -
				 cooling_per_s * (plant->temperature_c - ambient_c) + disturbance;

	plant->temperature_c += derivative * dt_s;
}

int32_t ivc_thermal_plant_temperature(const struct ivc_thermal_plant *plant)
{
	float scaled = plant->temperature_c * 1000.0F;

	return (int32_t)(scaled >= 0.0F ? scaled + 0.5F : scaled - 0.5F);
}
```

## src/endpoint.h
```c
/* SPDX-License-Identifier: Apache-2.0 */

#ifndef IVC_ENDPOINT_H_
#define IVC_ENDPOINT_H_

#include "protocol.h"

#include <stdbool.h>
#include <stdint.h>

#define IVC_RECEIVE_WINDOW_BITS 64U
#define IVC_RETIRED_SESSION_CAPACITY 8U
#define IVC_SAFE_ACTUATOR_PERMILLE 0U
#define IVC_COMMAND_TIMEOUT_US UINT64_C(500000)
#define IVC_MAXIMUM_COMMAND_AGE_US UINT64_C(250000)
#define IVC_INITIAL_SETPOINT_MILLI_C 45000
#define IVC_INITIAL_TEMPERATURE_MILLI_C 20000

struct ivc_receiver_metrics {
	uint64_t accepted;
	uint64_t duplicates;
	uint64_t reordered;
	uint64_t outside_window;
	uint64_t session_resets;
	uint64_t session_rejections;
};

struct ivc_receive_window {
	bool has_session;
	uint32_t session_id;
	uint32_t next_sequence;
	uint64_t received_mask;
	uint32_t retired_sessions[IVC_RETIRED_SESSION_CAPACITY];
	uint8_t retired_session_count;
	uint8_t retired_session_cursor;
	struct ivc_receiver_metrics metrics;
};

enum ivc_delivery {
	IVC_DELIVERY_NEW_SESSION,
	IVC_DELIVERY_NEW_IN_ORDER,
	IVC_DELIVERY_NEW_OUT_OF_ORDER,
	IVC_DELIVERY_DUPLICATE,
	IVC_DELIVERY_OUTSIDE_WINDOW,
	IVC_DELIVERY_INVALID_IDENTIFIER,
	IVC_DELIVERY_SEQUENCE_EXHAUSTED,
	IVC_DELIVERY_SESSION_REJECTED,
};

struct ivc_ack_loss_policy {
	uint32_t drop_every;
	uint64_t acknowledgements_dropped;
};

struct ivc_endpoint {
	enum ivc_control_mode active_mode;
	uint16_t actuator_permille;
	int32_t setpoint_milli_c;
	uint32_t last_sequence;
	bool has_last_sample;
	uint32_t last_sample_id;
	bool has_last_valid_command;
	uint64_t last_valid_command_us;
	enum ivc_error_code fault;
};

enum ivc_apply_result {
	IVC_APPLY_APPLIED,
	IVC_APPLY_ENTERED_SAFE_STATE,
	IVC_APPLY_INVALID_PAYLOAD,
	IVC_APPLY_FUTURE_TIMESTAMP,
	IVC_APPLY_STALE_TIMESTAMP,
	IVC_APPLY_STALE_SEQUENCE,
	IVC_APPLY_STALE_SAMPLE,
};

enum ivc_timeout_result {
	IVC_TIMEOUT_NO_CHANGE,
	IVC_TIMEOUT_ENTERED_SAFE_STATE,
	IVC_TIMEOUT_CLOCK_MOVED_BACKWARD,
};

struct ivc_thermal_plant {
	float temperature_c;
};

void ivc_receive_window_init(struct ivc_receive_window *window);

enum ivc_delivery ivc_receive_window_observe(struct ivc_receive_window *window,
					      uint32_t session_id, uint32_t sequence);

bool ivc_delivery_applies_control(enum ivc_delivery delivery);

struct ivc_ack_payload ivc_receive_window_ack(const struct ivc_receive_window *window,
					      uint32_t acknowledged_sequence);

void ivc_ack_loss_policy_init(struct ivc_ack_loss_policy *policy, uint32_t drop_every);

bool ivc_ack_loss_policy_should_drop(struct ivc_ack_loss_policy *policy,
				     enum ivc_delivery delivery, uint32_t sequence);

void ivc_endpoint_init(struct ivc_endpoint *endpoint);

void ivc_endpoint_begin_session(struct ivc_endpoint *endpoint);

enum ivc_apply_result ivc_endpoint_apply(struct ivc_endpoint *endpoint, uint32_t sequence,
					 const struct ivc_control_command *command,
					 uint64_t sent_at_us, uint64_t now_us);

enum ivc_timeout_result ivc_endpoint_check_timeout(struct ivc_endpoint *endpoint,
						   uint64_t now_us);

struct ivc_status_report ivc_endpoint_status(const struct ivc_endpoint *endpoint,
					     int32_t measured_milli_c);

const char *ivc_control_mode_name(enum ivc_control_mode mode);
const char *ivc_apply_result_name(enum ivc_apply_result result);

void ivc_thermal_plant_init(struct ivc_thermal_plant *plant);
void ivc_thermal_plant_step(struct ivc_thermal_plant *plant, uint16_t actuator_permille,
			    uint32_t step);
int32_t ivc_thermal_plant_temperature(const struct ivc_thermal_plant *plant);

#endif /* IVC_ENDPOINT_H_ */
```

## src/protocol.c
```c
/* SPDX-License-Identifier: Apache-2.0 */

#include "protocol.h"

#include <string.h>

#define IVC_CHECKSUM_OFFSET 28U

static const uint8_t ivc_magic[4] = {'I', 'V', 'C', '1'};

static uint16_t get_le16(const uint8_t *bytes)
{
	return (uint16_t)bytes[0] | ((uint16_t)bytes[1] << 8);
}

static uint32_t get_le32(const uint8_t *bytes)
{
	return (uint32_t)bytes[0] | ((uint32_t)bytes[1] << 8) |
	       ((uint32_t)bytes[2] << 16) | ((uint32_t)bytes[3] << 24);
}

static uint64_t get_le64(const uint8_t *bytes)
{
	return (uint64_t)get_le32(bytes) | ((uint64_t)get_le32(bytes + 4) << 32);
}

static void put_le16(uint8_t *bytes, uint16_t value)
{
	bytes[0] = (uint8_t)value;
	bytes[1] = (uint8_t)(value >> 8);
}

static void put_le32(uint8_t *bytes, uint32_t value)
{
	bytes[0] = (uint8_t)value;
	bytes[1] = (uint8_t)(value >> 8);
	bytes[2] = (uint8_t)(value >> 16);
	bytes[3] = (uint8_t)(value >> 24);
}

static void put_le64(uint8_t *bytes, uint64_t value)
{
	put_le32(bytes, (uint32_t)value);
	put_le32(bytes + 4, (uint32_t)(value >> 32));
}

static bool message_type_valid(uint8_t value)
{
	return value >= IVC_MESSAGE_CONTROL && value <= IVC_MESSAGE_TELEMETRY;
}

static bool error_code_valid(uint16_t value)
{
	return value <= IVC_ERROR_INTERNAL;
}

static bool mode_valid(uint8_t value)
{
	return value <= IVC_MODE_NEURAL;
}

static bool operation_valid(uint8_t value)
{
	return value >= IVC_CONTROL_SET_ACTUATOR && value <= IVC_CONTROL_HEARTBEAT;
}

static bool temperature_valid(int32_t value)
{
	return value >= IVC_MIN_TEMPERATURE_MILLI_C &&
	       value <= IVC_MAX_TEMPERATURE_MILLI_C;
}

static bool frame_error_code_valid(enum ivc_message_type message_type,
				   enum ivc_error_code error_code)
{
	if (!error_code_valid((uint16_t)error_code)) {
		return false;
	}
	if (message_type == IVC_MESSAGE_ERROR) {
		return error_code != IVC_ERROR_NONE;
	}
	return error_code == IVC_ERROR_NONE;
}

static uint32_t crc32_update(uint32_t crc, uint8_t byte)
{
	crc ^= byte;
	for (unsigned int bit = 0; bit < 8U; ++bit) {
		uint32_t mask = (uint32_t)-(int32_t)(crc & 1U);

		crc = (crc >> 1) ^ (UINT32_C(0xedb88320) & mask);
	}
	return crc;
}

uint32_t ivc_crc32_bytes(const uint8_t *bytes, size_t length)
{
	uint32_t crc = UINT32_MAX;

	for (size_t index = 0; index < length; ++index) {
		crc = crc32_update(crc, bytes[index]);
	}
	return ~crc;
}

uint32_t ivc_crc32(const uint8_t *frame, size_t frame_length)
{
	uint32_t crc = UINT32_MAX;

	for (size_t index = 0; index < frame_length; ++index) {
		uint8_t byte = frame[index];

		if (index >= IVC_CHECKSUM_OFFSET && index < IVC_CHECKSUM_OFFSET + 4U) {
			byte = 0U;
		}
		crc = crc32_update(crc, byte);
	}
	return ~crc;
}

bool ivc_encode_frame(const struct ivc_header *header, const uint8_t *payload,
		      uint8_t *frame, size_t frame_capacity, size_t *frame_length)
{
	size_t encoded_length;

	if (header == NULL || frame == NULL || frame_length == NULL ||
	    !message_type_valid((uint8_t)header->message_type) ||
	    (header->flags & ~IVC_VALID_FLAGS) != 0U ||
	    header->payload_length > IVC_MAX_PAYLOAD_LENGTH ||
	    !frame_error_code_valid(header->message_type, header->error_code) ||
	    (header->payload_length != 0U && payload == NULL)) {
		return false;
	}
	encoded_length = IVC_HEADER_LENGTH + header->payload_length;
	if (frame_capacity < encoded_length) {
		return false;
	}

	memcpy(frame, ivc_magic, sizeof(ivc_magic));
	frame[4] = IVC_PROTOCOL_VERSION;
	frame[5] = (uint8_t)header->message_type;
	put_le16(frame + 6, header->flags);
	put_le32(frame + 8, header->session_id);
	put_le32(frame + 12, header->sequence);
	put_le64(frame + 16, header->timestamp_us);
	put_le16(frame + 24, header->payload_length);
	put_le16(frame + 26, (uint16_t)header->error_code);
	put_le32(frame + IVC_CHECKSUM_OFFSET, 0U);
	if (header->payload_length != 0U) {
		memcpy(frame + IVC_HEADER_LENGTH, payload, header->payload_length);
	}
	put_le32(frame + IVC_CHECKSUM_OFFSET, ivc_crc32(frame, encoded_length));
	*frame_length = encoded_length;
	return true;
}

enum ivc_decode_result ivc_decode_frame(const uint8_t *frame, size_t frame_length,
					struct ivc_frame_view *view)
{
	uint8_t message_type;
	uint16_t flags;
	uint16_t payload_length;
	uint16_t error_code;

	if (frame == NULL || view == NULL || frame_length < IVC_HEADER_LENGTH) {
		return IVC_DECODE_TOO_SHORT;
	}
	if (memcmp(frame, ivc_magic, sizeof(ivc_magic)) != 0) {
		return IVC_DECODE_BAD_MAGIC;
	}
	if (frame[4] != IVC_PROTOCOL_VERSION) {
		return IVC_DECODE_UNSUPPORTED_VERSION;
	}
	message_type = frame[5];
	if (!message_type_valid(message_type)) {
		return IVC_DECODE_UNKNOWN_MESSAGE_TYPE;
	}
	flags = get_le16(frame + 6);
	if ((flags & ~IVC_VALID_FLAGS) != 0U) {
		return IVC_DECODE_INVALID_FLAGS;
	}
	payload_length = get_le16(frame + 24);
	if (payload_length > IVC_MAX_PAYLOAD_LENGTH) {
		return IVC_DECODE_PAYLOAD_TOO_LARGE;
	}
	if (frame_length != IVC_HEADER_LENGTH + payload_length) {
		return IVC_DECODE_LENGTH_MISMATCH;
	}
	error_code = get_le16(frame + 26);
	if (!frame_error_code_valid((enum ivc_message_type)message_type,
				    (enum ivc_error_code)error_code)) {
		return IVC_DECODE_INVALID_ERROR_CODE;
	}
	if (get_le32(frame + IVC_CHECKSUM_OFFSET) != ivc_crc32(frame, frame_length)) {
		return IVC_DECODE_CHECKSUM_MISMATCH;
	}

	view->header = (struct ivc_header){
		.message_type = (enum ivc_message_type)message_type,
		.flags = flags,
		.session_id = get_le32(frame + 8),
		.sequence = get_le32(frame + 12),
		.timestamp_us = get_le64(frame + 16),
		.payload_length = payload_length,
		.error_code = (enum ivc_error_code)error_code,
	};
	view->payload = frame + IVC_HEADER_LENGTH;
	return IVC_DECODE_OK;
}

bool ivc_decode_rejection_context(const uint8_t *frame, size_t frame_length,
				  enum ivc_decode_result decode_result,
				  struct ivc_decode_rejection *rejection)
{
	enum ivc_error_code response_error;
	uint32_t session_id;
	uint32_t sequence;

	if (frame == NULL || rejection == NULL || frame_length < IVC_HEADER_LENGTH ||
	    memcmp(frame, ivc_magic, sizeof(ivc_magic)) != 0 ||
	    !message_type_valid(frame[5])) {
		return false;
	}
	switch (decode_result) {
	case IVC_DECODE_UNSUPPORTED_VERSION:
		response_error = IVC_ERROR_UNSUPPORTED_VERSION;
		break;
	case IVC_DECODE_CHECKSUM_MISMATCH:
		response_error = IVC_ERROR_CHECKSUM_MISMATCH;
		break;
	case IVC_DECODE_INVALID_FLAGS:
	case IVC_DECODE_PAYLOAD_TOO_LARGE:
	case IVC_DECODE_LENGTH_MISMATCH:
	case IVC_DECODE_INVALID_ERROR_CODE:
		response_error = IVC_ERROR_MALFORMED_FRAME;
		break;
	default:
		return false;
	}
	session_id = get_le32(frame + 8);
	sequence = get_le32(frame + 12);
	if (session_id == 0U || sequence == 0U) {
		return false;
	}
	rejection->request = (struct ivc_header){
		.message_type = (enum ivc_message_type)frame[5],
		.flags = get_le16(frame + 6),
		.session_id = session_id,
		.sequence = sequence,
		.timestamp_us = get_le64(frame + 16),
		.payload_length = get_le16(frame + 24),
		.error_code = IVC_ERROR_NONE,
	};
	rejection->response_error = response_error;
	return true;
}

const char *ivc_decode_result_name(enum ivc_decode_result result)
{
	switch (result) {
	case IVC_DECODE_OK:
		return "ok";
	case IVC_DECODE_TOO_SHORT:
		return "frame-too-short";
	case IVC_DECODE_BAD_MAGIC:
		return "bad-magic";
	case IVC_DECODE_UNSUPPORTED_VERSION:
		return "unsupported-version";
	case IVC_DECODE_UNKNOWN_MESSAGE_TYPE:
		return "unknown-message-type";
	case IVC_DECODE_INVALID_FLAGS:
		return "invalid-flags";
	case IVC_DECODE_PAYLOAD_TOO_LARGE:
		return "payload-too-large";
	case IVC_DECODE_LENGTH_MISMATCH:
		return "length-mismatch";
	case IVC_DECODE_INVALID_ERROR_CODE:
		return "invalid-error-code";
	case IVC_DECODE_CHECKSUM_MISMATCH:
		return "checksum-mismatch";
	default:
		return "unknown-decode-result";
	}
}

bool ivc_encode_control(const struct ivc_control_command *command,
			uint8_t payload[IVC_CONTROL_PAYLOAD_LENGTH])
{
	if (command == NULL || payload == NULL ||
	    !operation_valid((uint8_t)command->operation) || !mode_valid((uint8_t)command->mode) ||
	    command->actuator_permille > IVC_MAX_ACTUATOR_PERMILLE ||
	    !temperature_valid(command->setpoint_milli_c) ||
	    (command->operation == IVC_CONTROL_ENTER_SAFE_STATE && command->mode != IVC_MODE_SAFE)) {
		return false;
	}
	payload[0] = (uint8_t)command->operation;
	payload[1] = (uint8_t)command->mode;
	put_le16(payload + 2, command->actuator_permille);
	put_le32(payload + 4, (uint32_t)command->setpoint_milli_c);
	put_le32(payload + 8, command->sample_id);
	return true;
}

bool ivc_decode_control(const uint8_t *payload, size_t payload_length,
			struct ivc_control_command *command)
{
	struct ivc_control_command decoded;

	if (payload == NULL || command == NULL || payload_length != IVC_CONTROL_PAYLOAD_LENGTH) {
		return false;
	}
	decoded = (struct ivc_control_command){
		.operation = (enum ivc_control_operation)payload[0],
		.mode = (enum ivc_control_mode)payload[1],
		.actuator_permille = get_le16(payload + 2),
		.setpoint_milli_c = (int32_t)get_le32(payload + 4),
		.sample_id = get_le32(payload + 8),
	};
	if (!operation_valid(payload[0]) || !mode_valid(payload[1]) ||
	    decoded.actuator_permille > IVC_MAX_ACTUATOR_PERMILLE ||
	    !temperature_valid(decoded.setpoint_milli_c) ||
	    (decoded.operation == IVC_CONTROL_ENTER_SAFE_STATE && decoded.mode != IVC_MODE_SAFE)) {
		return false;
	}
	*command = decoded;
	return true;
}

bool ivc_encode_status(const struct ivc_status_report *status,
		       uint8_t payload[IVC_STATUS_PAYLOAD_LENGTH])
{
	bool fault_state;

	if (status == NULL || payload == NULL || status->state < IVC_STATUS_READY ||
	    status->state > IVC_STATUS_FAULT || !mode_valid((uint8_t)status->active_mode) ||
	    status->actuator_permille > IVC_MAX_ACTUATOR_PERMILLE ||
	    !temperature_valid(status->measured_milli_c) ||
	    !temperature_valid(status->setpoint_milli_c) ||
	    !error_code_valid((uint16_t)status->fault)) {
		return false;
	}
	fault_state = status->state == IVC_STATUS_FAULT;
	if ((fault_state && status->fault == IVC_ERROR_NONE) ||
	    (!fault_state && status->state != IVC_STATUS_SAFE_FALLBACK &&
	     status->fault != IVC_ERROR_NONE)) {
		return false;
	}
	payload[0] = (uint8_t)status->state;
	payload[1] = (uint8_t)status->active_mode;
	put_le16(payload + 2, status->actuator_permille);
	put_le32(payload + 4, (uint32_t)status->measured_milli_c);
	put_le32(payload + 8, (uint32_t)status->setpoint_milli_c);
	put_le32(payload + 12, status->applied_sequence);
	put_le16(payload + 16, (uint16_t)status->fault);
	put_le16(payload + 18, 0U);
	return true;
}

bool ivc_encode_ack(const struct ivc_ack_payload *ack,
		    uint8_t payload[IVC_ACK_PAYLOAD_LENGTH])
{
	if (ack == NULL || payload == NULL) {
		return false;
	}
	put_le32(payload, ack->acknowledged_sequence);
	put_le32(payload + 4, ack->next_expected_sequence);
	put_le32(payload + 8, ack->received_mask);
	return true;
}

bool ivc_encode_error_payload(const struct ivc_error_payload *error,
			      uint8_t payload[IVC_ERROR_PAYLOAD_LENGTH])
{
	if (error == NULL || payload == NULL ||
	    !message_type_valid((uint8_t)error->offending_message_type)) {
		return false;
	}
	payload[0] = (uint8_t)error->offending_message_type;
	payload[1] = 0U;
	payload[2] = 0U;
	payload[3] = 0U;
	put_le32(payload + 4, error->offending_sequence);
	return true;
}

bool ivc_protocol_self_test(void)
{
	static const uint8_t expected_frame[] = {
		0x49, 0x56, 0x43, 0x31, 0x01, 0x01, 0x01, 0x00,
		0x04, 0x03, 0x02, 0x01, 0x08, 0x07, 0x06, 0x05,
		0x18, 0x17, 0x16, 0x15, 0x14, 0x13, 0x12, 0x11,
		0x02, 0x00, 0x00, 0x00, 0xea, 0x5d, 0x15, 0xfe,
		0xaa, 0x55,
	};
	static const uint8_t expected_control[] = {
		0x01, 0x02, 0x71, 0x02, 0xd8, 0xd6,
		0x00, 0x00, 0x04, 0x03, 0x02, 0x01,
	};
	const struct ivc_header header = {
		.message_type = IVC_MESSAGE_CONTROL,
		.flags = IVC_FLAG_ACK_REQUIRED,
		.session_id = UINT32_C(0x01020304),
		.sequence = UINT32_C(0x05060708),
		.timestamp_us = UINT64_C(0x1112131415161718),
		.payload_length = 2U,
		.error_code = IVC_ERROR_NONE,
	};
	const struct ivc_control_command command = {
		.operation = IVC_CONTROL_SET_ACTUATOR,
		.mode = IVC_MODE_NEURAL,
		.actuator_permille = 625U,
		.setpoint_milli_c = 55000,
		.sample_id = UINT32_C(0x01020304),
	};
	const uint8_t frame_payload[] = {0xaa, 0x55};
	uint8_t frame[sizeof(expected_frame)];
	uint8_t control[sizeof(expected_control)];
	struct ivc_frame_view view;
	struct ivc_control_command decoded_command;
	size_t frame_length = 0U;

	return ivc_encode_frame(&header, frame_payload, frame, sizeof(frame), &frame_length) &&
	       frame_length == sizeof(expected_frame) &&
	       memcmp(frame, expected_frame, sizeof(expected_frame)) == 0 &&
	       ivc_decode_frame(frame, frame_length, &view) == IVC_DECODE_OK &&
	       view.header.session_id == header.session_id &&
	       view.header.sequence == header.sequence &&
	       view.header.timestamp_us == header.timestamp_us &&
	       memcmp(view.payload, frame_payload, sizeof(frame_payload)) == 0 &&
	       ivc_encode_control(&command, control) &&
	       memcmp(control, expected_control, sizeof(expected_control)) == 0 &&
	       ivc_decode_control(control, sizeof(control), &decoded_command) &&
	       decoded_command.operation == command.operation && decoded_command.mode == command.mode &&
	       decoded_command.actuator_permille == command.actuator_permille &&
	       decoded_command.setpoint_milli_c == command.setpoint_milli_c &&
	       decoded_command.sample_id == command.sample_id;
}
```

## src/protocol.h
```c
/* SPDX-License-Identifier: Apache-2.0 */

#ifndef IVC_PROTOCOL_H_
#define IVC_PROTOCOL_H_

#include <stdbool.h>
#include <stddef.h>
#include <stdint.h>

#define IVC_PROTOCOL_VERSION 1U
#define IVC_HEADER_LENGTH 32U
#define IVC_MAX_PAYLOAD_LENGTH 1200U
#define IVC_MAX_FRAME_LENGTH (IVC_HEADER_LENGTH + IVC_MAX_PAYLOAD_LENGTH)

#define IVC_CONTROL_PAYLOAD_LENGTH 12U
#define IVC_STATUS_PAYLOAD_LENGTH 20U
#define IVC_ACK_PAYLOAD_LENGTH 12U
#define IVC_ERROR_PAYLOAD_LENGTH 8U

#define IVC_FLAG_ACK_REQUIRED UINT16_C(0x0001)
#define IVC_FLAG_RETRANSMISSION UINT16_C(0x0002)
#define IVC_VALID_FLAGS (IVC_FLAG_ACK_REQUIRED | IVC_FLAG_RETRANSMISSION)

#define IVC_MIN_TEMPERATURE_MILLI_C (-40000)
#define IVC_MAX_TEMPERATURE_MILLI_C 150000
#define IVC_MAX_ACTUATOR_PERMILLE 1000U

enum ivc_message_type {
	IVC_MESSAGE_CONTROL = 1,
	IVC_MESSAGE_STATUS = 2,
	IVC_MESSAGE_ERROR = 3,
	IVC_MESSAGE_ACK = 4,
	IVC_MESSAGE_TELEMETRY = 5,
};

enum ivc_error_code {
	IVC_ERROR_NONE = 0,
	IVC_ERROR_MALFORMED_FRAME = 1,
	IVC_ERROR_UNSUPPORTED_VERSION = 2,
	IVC_ERROR_CHECKSUM_MISMATCH = 3,
	IVC_ERROR_SEQUENCE_OUTSIDE_WINDOW = 4,
	IVC_ERROR_INVALID_CONTROL = 5,
	IVC_ERROR_STALE_CONTROL = 6,
	IVC_ERROR_ACTUATOR_RANGE = 7,
	IVC_ERROR_CONTROLLER_TIMEOUT = 8,
	IVC_ERROR_INTERNAL = 9,
};

enum ivc_control_operation {
	IVC_CONTROL_SET_ACTUATOR = 1,
	IVC_CONTROL_ENTER_SAFE_STATE = 2,
	IVC_CONTROL_HEARTBEAT = 3,
};

enum ivc_control_mode {
	IVC_MODE_SAFE = 0,
	IVC_MODE_MANUAL_FIXED = 1,
	IVC_MODE_NEURAL = 2,
};

enum ivc_status_state {
	IVC_STATUS_READY = 1,
	IVC_STATUS_APPLIED = 2,
	IVC_STATUS_SAFE_FALLBACK = 3,
	IVC_STATUS_FAULT = 4,
};

enum ivc_decode_result {
	IVC_DECODE_OK = 0,
	IVC_DECODE_TOO_SHORT,
	IVC_DECODE_BAD_MAGIC,
	IVC_DECODE_UNSUPPORTED_VERSION,
	IVC_DECODE_UNKNOWN_MESSAGE_TYPE,
	IVC_DECODE_INVALID_FLAGS,
	IVC_DECODE_PAYLOAD_TOO_LARGE,
	IVC_DECODE_LENGTH_MISMATCH,
	IVC_DECODE_INVALID_ERROR_CODE,
	IVC_DECODE_CHECKSUM_MISMATCH,
};

struct ivc_header {
	enum ivc_message_type message_type;
	uint16_t flags;
	uint32_t session_id;
	uint32_t sequence;
	uint64_t timestamp_us;
	uint16_t payload_length;
	enum ivc_error_code error_code;
};

struct ivc_frame_view {
	struct ivc_header header;
	const uint8_t *payload;
};

struct ivc_decode_rejection {
	struct ivc_header request;
	enum ivc_error_code response_error;
};

struct ivc_control_command {
	enum ivc_control_operation operation;
	enum ivc_control_mode mode;
	uint16_t actuator_permille;
	int32_t setpoint_milli_c;
	uint32_t sample_id;
};

struct ivc_status_report {
	enum ivc_status_state state;
	enum ivc_control_mode active_mode;
	uint16_t actuator_permille;
	int32_t measured_milli_c;
	int32_t setpoint_milli_c;
	uint32_t applied_sequence;
	enum ivc_error_code fault;
};

struct ivc_ack_payload {
	uint32_t acknowledged_sequence;
	uint32_t next_expected_sequence;
	uint32_t received_mask;
};

struct ivc_error_payload {
	enum ivc_message_type offending_message_type;
	uint32_t offending_sequence;
};

uint32_t ivc_crc32_bytes(const uint8_t *bytes, size_t length);

uint32_t ivc_crc32(const uint8_t *frame, size_t frame_length);

bool ivc_encode_frame(const struct ivc_header *header, const uint8_t *payload,
		      uint8_t *frame, size_t frame_capacity, size_t *frame_length);

enum ivc_decode_result ivc_decode_frame(const uint8_t *frame, size_t frame_length,
					struct ivc_frame_view *view);

bool ivc_decode_rejection_context(const uint8_t *frame, size_t frame_length,
				  enum ivc_decode_result decode_result,
				  struct ivc_decode_rejection *rejection);

const char *ivc_decode_result_name(enum ivc_decode_result result);

bool ivc_encode_control(const struct ivc_control_command *command,
			uint8_t payload[IVC_CONTROL_PAYLOAD_LENGTH]);

bool ivc_decode_control(const uint8_t *payload, size_t payload_length,
			struct ivc_control_command *command);

bool ivc_encode_status(const struct ivc_status_report *status,
		       uint8_t payload[IVC_STATUS_PAYLOAD_LENGTH]);

bool ivc_encode_ack(const struct ivc_ack_payload *ack,
		    uint8_t payload[IVC_ACK_PAYLOAD_LENGTH]);

bool ivc_encode_error_payload(const struct ivc_error_payload *error,
			      uint8_t payload[IVC_ERROR_PAYLOAD_LENGTH]);

bool ivc_protocol_self_test(void);

#endif /* IVC_PROTOCOL_H_ */
```
